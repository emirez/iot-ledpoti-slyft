
// Generated by slyft.io
// This code part has been generated on an "as is" basis, without warranties or conditions of any kind.


#include "Arduino.h"

#include "led.h"
#include "mpack/mpack.h"
#include "mpack/mpack-platform.h"

void TUTCI__led_clean(struct TUTCI__led *self) {

	self->ledstate = 0;
}

void TUTCI__led_parse_next(struct TUTCI__led *self, mpack_reader_t *reader) {

	char	buf_key[9];
	mpack_expect_utf8_cstr(reader, buf_key, sizeof(buf_key));


	if (mpack_memcmp("ledstate",(const char*)buf_key,8) == 0) {
		self->ledstate = mpack_expect_i32(reader);
	}


}

int TUTCI__led_parse(struct TUTCI__led *self, const uint8_t *input_buf, size_t sz_input_buf) {
		mpack_reader_t reader;
    mpack_error_t error;

    mpack_reader_init_data(&reader,(const char *)input_buf, sz_input_buf);
    self->TUTCI__led_parse_mpack(self, &reader);

    error = mpack_reader_destroy(&reader);
    if ( error != mpack_ok) {
        return 1;
    } else {
        return 0;
    }

}

void TUTCI__led_parse_mpack(struct TUTCI__led *self, mpack_reader_t *reader) {

    int count = mpack_expect_map_range(reader, 1, 1);
    for (int i = 0; i < count; i++) {
        TUTCI__led_parse_next(self, reader);
    }

    mpack_done_map(reader);
}

size_t TUTCI__led_serialize(const struct TUTCI__led *self, uint8_t *output_buf, size_t sz_output_buf) {
		struct mpack_writer_t writer;
    mpack_writer_init(&writer,(char*)output_buf,sz_output_buf);

		self->TUTCI__led_serialize_mpack(self, &writer);

    size_t used = mpack_writer_buffer_used(&writer);

    // if all is ok, return length of used bytes. Otherwise 0
    if (mpack_writer_destroy(&writer) == mpack_ok) {
        return used;
    } else {
        return (size_t)0;
    }
}

void TUTCI__led_serialize_mpack(const struct TUTCI__led *self, mpack_writer_t *writer) {
    mpack_start_map(writer, 1);

	mpack_write_cstr(writer, "ledstate"); mpack_write_i32(writer, self->ledstate);

    mpack_finish_map(writer);
}

void TUTCI__led_init(struct TUTCI__led *self) {
    self->TUTCI__led_clean = &TUTCI__led_clean;
    self->TUTCI__led_parse = &TUTCI__led_parse;
    self->TUTCI__led_parse_mpack = &TUTCI__led_parse_mpack;
    self->TUTCI__led_serialize = &TUTCI__led_serialize;
    self->TUTCI__led_serialize_mpack = &TUTCI__led_serialize_mpack;
    self->TUTCI__led_clean(self);
}

//
